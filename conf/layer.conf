## conf/layer.conf
```bitbake
# We have a conf and classes directory, add to BBPATH
BBPATH .= ":${LAYERDIR}"

# We have recipes-* directories, add to BBFILES
BBFILES += "${LAYERDIR}/recipes-*/*/*.bb \
	${LAYERDIR}/recipes-*/*/*.bbappend"

BBFILE_COLLECTIONS += "murata-wireless"
BBFILE_PATTERN_murata-wireless = "^${LAYERDIR}/"
BBFILE_PRIORITY_murata-wireless = "9"

LAYERSERIES_COMPAT_murata-wireless = "styhead"


#BBMASK += "/meta-fsl-bsp-release/imx/meta-bsp/recipes-connectivity/hostapd/"
#BBMASK += "/meta-fsl-bsp-release/imx/meta-bsp/recipes-connectivity/wpa-supplicant/"
#BBMASK += "/meta-freescale-3rdparty/recipes-kernel/linux-firmware/"
#BBMASK += "/meta-imx/meta-imx-bsp/recipes-kernel/linux-firmware/linux-firmware_%.bbappend"
#BBMASK += "/meta-freescale/recipes-bsp/firmware-imx/firmware-nxp-wifi_1.0.bb"
#BBMASK += "/meta-imx/meta-imx-bsp/recipes-bsp/firmware-imx/firmware-nxp-wifi_%.bbappend"
```
